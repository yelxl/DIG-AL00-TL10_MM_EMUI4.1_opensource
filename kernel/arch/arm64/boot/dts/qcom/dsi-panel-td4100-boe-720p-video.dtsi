/* Copyright (c) 2013, The Linux Foundation. All rights reserved.
 *
 * This program is free software; you can redistribute it and/or modify
 * it under the terms of the GNU General Public License version 2 and
 * only version 2 as published by the Free Software Foundation.
 *
 * This program is distributed in the hope that it will be useful,
 * but WITHOUT ANY WARRANTY; without even the implied warranty of
 * MERCHANTABILITY or FITNESS FOR A PARTICULAR PURPOSE.  See the
 * GNU General Public License for more details.
 */

/*---------------------------------------------------------------------------
 * This file is autogenerated file using gcdb parser. Please do not edit it.
 * Update input XML file to add a new entry or update variable in this file
 * VERSION = "1.0"
 *---------------------------------------------------------------------------*/
&mdss_mdp {
	dsi_td4100_boe_720_video: qcom,mdss_dsi_td4100_boe_720p_video {
		qcom,mdss-dsi-panel-name = "TD4100_720p_video_BOE";
		qcom,mdss-dsi-panel-controller = <&mdss_dsi0>;
		qcom,mdss-dsi-panel-type = "dsi_video_mode";
		qcom,mdss-dsi-panel-destination = "display_1";
		qcom,mdss-dsi-panel-framerate = <60>;
		qcom,mdss-dsi-virtual-channel-id = <0>;
		qcom,mdss-dsi-stream = <0>;
		qcom,mdss-dsi-panel-width = <720>;
		qcom,mdss-dsi-panel-height = <1280>;
		qcom,mdss-pan-physical-width-dimension = <62>;
		qcom,mdss-pan-physical-height-dimension = <110>;
		qcom,mdss-dsi-h-front-porch = <256>;
		qcom,mdss-dsi-h-back-porch = <80>;
		qcom,mdss-dsi-h-pulse-width = <44>;
		qcom,mdss-dsi-h-sync-skew = <0>;
		qcom,mdss-dsi-v-back-porch = <42>;
		qcom,mdss-dsi-v-front-porch = <50>;
		qcom,mdss-dsi-v-pulse-width = <10>;
		qcom,mdss-dsi-h-left-border = <0>;
		qcom,mdss-dsi-h-right-border = <0>;
		qcom,mdss-dsi-v-top-border = <0>;
		qcom,mdss-dsi-v-bottom-border = <0>;//20
		qcom,mdss-dsi-bpp = <24>;
		qcom,mdss-dsi-underflow-color = <0xff>;
                qcom,mdss-dsi-border-color = <0>;
                qcom,mdss-dsi-on-command = [05 01 00 00 55 00 02 11 00
                        05 01 00 00 00 00 02 29 00];
                qcom,mdss-dsi-off-command = [05 01 00 00 00 00 02 28 00
                        05 01 00 00 55 00 02 10 00];
                qcom,mdss-dsi-on-command-state = "dsi_hs_mode";
		qcom,mdss-dsi-off-command-state = "dsi_hs_mode";
		qcom,mdss-dsi-h-sync-pulse = <1>;
		qcom,mdss-dsi-traffic-mode = "non_burst_sync_pulse"; //"non_burst_sync_event";
		qcom,mdss-dsi-bllp-eof-power-mode;
		qcom,mdss-dsi-bllp-power-mode;
		qcom,mdss-dsi-lane-0-state;
		qcom,mdss-dsi-lane-1-state;
		qcom,mdss-dsi-lane-2-state;
                qcom,mdss-dsi-lane-3-state;
		qcom,mdss-dsi-panel-timings = [98 22 16 00 4A 4E 1A 26 1A 03 04 00];
		qcom,mdss-dsi-t-clk-post = <0x04>;
		qcom,mdss-dsi-t-clk-pre = <0x1E>;
		qcom,mdss-dsi-bl-min-level = <35>;
		qcom,mdss-dsi-bl-max-level = <4095>;
		qcom,mdss-dsi-bl-half-level = <1620>;  //the value between bl-max and bl-min
		qcom,mdss-dsi-bl-target-level = <835>;//change half-level to target-level
		qcom,mdss-dsi-dma-trigger = "trigger_sw";
		qcom,mdss-dsi-mdp-trigger = "none";
		qcom,mdss-dsi-bl-pmic-control-type = "bl_ctrl_wled";
                qcom,panel-esd-check-enabled;
                qcom,panel-esd-read-commands = [06 01 00 01 05 00 02 0A 1C
						06 01 00 01 FE 00 02 EB 00];
                qcom,esd-read-cmds-state = "dsi_hs_mode";
                huawei,long-read-flag = <1>;
                huawei,reg-read-expect-value = <0x1C>;
                huawei,reg-long-read-count = <3>;
                qcom,mdss-dsi-reset-sequence = <0 5>, <1 85>;
                qcom,mdss-dsi-tx-eot-append;
                qcom,mdss-dsi-lp11-init;
                qcom,mdss-dsi-init-delay-us = <1000>;

	};
};
