/{
		huawei_fac_info {
		compatible = "huawei,hw_fac_info";
		fac,product_name = "DIG-L22HN";
		fac,hardware_ver = "HL1DIEGO";
		fac,software_ver = "DIG_L22HN_VA";
		fac,simcard_adapt = "support";
		status = "ok";
	};
};
