## kernel/drivers/input/touchscreen/synaptics_dsx_2.6.8/Kconfig
```kconfig
#
# Synaptics DSX v2.6.8 touchscreen driver configuration
#
menuconfig TOUCHSCREEN_SYNAPTICS_DSX_v268
	bool "Synaptics DSX _v2.6.8 touchscreen"
	default y
	help
	  Say Y here if you have a Synaptics DSX touchscreen connected
	  to your system.

	  If unsure, say N.

if TOUCHSCREEN_SYNAPTICS_DSX_v268

choice
	default TOUCHSCREEN_SYNAPTICS_DSX_I2C_v268
	prompt "Synaptics DSX v2.6.8 bus interface"
config TOUCHSCREEN_SYNAPTICS_DSX_I2C_v268
	bool "RMI over I2C"
	depends on I2C
config TOUCHSCREEN_SYNAPTICS_DSX_SPI_v268
	bool "RMI over SPI"
	depends on SPI_MASTER
config TOUCHSCREEN_SYNAPTICS_DSX_RMI_HID_I2C_v268
	bool "HID over I2C"
	depends on I2C
endchoice

config TOUCHSCREEN_SYNAPTICS_DSX_CORE_v268
	tristate "Synaptics DSX v2.6.8 core driver module"
	depends on I2C || SPI_MASTER
	help
	  Say Y here to enable basic touch reporting functionality.

	  If unsure, say N.

	  To compile this driver as a module, choose M here: the
	  module will be called synaptics_dsx_core.

config TOUCHSCREEN_SYNAPTICS_DSX_RMI_DEV_v268
	tristate "Synaptics DSX v2.6.8 RMI device module"
	depends on TOUCHSCREEN_SYNAPTICS_DSX_CORE_v268
	help
	  Say Y here to enable support for direct RMI register access.

	  If unsure, say N.

	  To compile this driver as a module, choose M here: the
	  module will be called synaptics_dsx_rmi_dev.

config TOUCHSCREEN_SYNAPTICS_DSX_FW_UPDATE_v268
	tristate "Synaptics DSX v2.6.8 firmware update module"
	depends on TOUCHSCREEN_SYNAPTICS_DSX_CORE_v268
	help
	  Say Y here to enable support for doing firmware update.

	  If unsure, say N.

	  To compile this driver as a module, choose M here: the
	  module will be called synaptics_dsx_fw_update.

config TOUCHSCREEN_SYNAPTICS_DSX_TEST_REPORTING_v268
	tristate "Synaptics DSX v2.6.8 test reporting module"
	depends on TOUCHSCREEN_SYNAPTICS_DSX_CORE_v268
	help
	  Say Y here to enable support for retrieving production test reports.

	  If unsure, say N.

	  To compile this driver as a module, choose M here: the
	  module will be called synaptics_dsx_test_reporting.

config TOUCHSCREEN_SYNAPTICS_DSX_PROXIMITY_v268
	tristate "Synaptics DSX v2.6.8 proximity module"
	depends on TOUCHSCREEN_SYNAPTICS_DSX_CORE_v268
	help
	  Say Y here to enable support for proximity functionality.

	  If unsure, say N.

	  To compile this driver as a module, choose M here: the
	  module will be called synaptics_dsx_proximity.

config TOUCHSCREEN_SYNAPTICS_DSX_ACTIVE_PEN_v268
	tristate "Synaptics DSX v2.6.8 active pen module"
	depends on TOUCHSCREEN_SYNAPTICS_DSX_CORE_v268
	help
	  Say Y here to enable support for active pen functionality.

	  If unsure, say N.

	  To compile this driver as a module, choose M here: the
	  module will be called synaptics_dsx_active_pen.

config TOUCHSCREEN_SYNAPTICS_DSX_GESTURE_v268
	tristate "Synaptics DSX v2.6.8 user defined gesture module"
	depends on TOUCHSCREEN_SYNAPTICS_DSX_CORE_v268
	help
	  Say Y here to enable support for user defined gesture functionality.

	  If unsure, say N.

	  To compile this driver as a module, choose M here: the
	  module will be called synaptics_dsx_gesture.

config TOUCHSCREEN_SYNAPTICS_DSX_VIDEO_v268
	tristate "Synaptics DSX v2.6.8 video module"
	depends on TOUCHSCREEN_SYNAPTICS_DSX_CORE_v268
	help
	  Say Y here to enable support for video communication functionality.

	  If unsure, say N.

	  To compile this driver as a module, choose M here: the
	  module will be called synaptics_dsx_video.

endif
```
